## drivers/misc/hwcfg/Kconfig
```kconfig
config GPIO_DIP
	tristate "GPIO DIP switches for hardware configuration driver"
	depends on GPIOLIB
	help
	  This enables a generic driver for reading a set of parallel GPIO
	  lines from DIP switches and representing them as a single numerical
	  value.

	  The driver always interprets the GPIOs in LSB-first order. The
	  first GPIO listed in the 'gpios' device tree property corresponds
	  to bit 0, the second to bit 1, and so on. To achieve an MSB-first
	  result, list the GPIOs in reverse order in the device tree.

	  The driver performs a one-time read during boot and caches the
	  value. It can then derive multiple values by adding device tree
	  child nodes.

	  To compile this driver as a module, choose M here: the
	  module will be called gpio-dip.
```

## drivers/net/can/tcp/Kconfig
```kconfig
# SPDX-License-Identifier: GPL-2.0-only

menu "CAN TCP interfaces"
	depends on NET

config CAN_TCP_SLCAN
	tristate "Serial line CAN over TCP"
	depends on STREAM_PARSER
	help
	  This driver creates a standard SocketCAN network interface (canX)
	  that communicates using the ASCII SLCAN protocol. Unlike the
	  standard slcan driver that attaches to a TTY/Serial port, this
	  driver utilizes a TCP socket passed from userspace via ioctl.

	  It uses the kernel's strparser (Stream Parser) for efficient
	  message framing in kernel space.

	  To compile this driver as a module, choose M here: the module
	  will be called tcp_slcan.

endmenu
```

## net/strparser/Kconfig
```kconfig
# SPDX-License-Identifier: GPL-2.0-only
config STREAM_PARSER
	tristate "Stream Parser"
	default n
```
